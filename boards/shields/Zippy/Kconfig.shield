## boards/shields/Zippy/Kconfig.shield
```kconfig
# Copyright (c) 2020 The ZMK Contributors
# SPDX-License-Identifier: MIT

config SHIELD_Zippy2_CENTRAL_DONGLE
	def_bool $(shields_list_contains,Zippy2_central_dongle)

config SHIELD_Zippy2_CENTRAL_LEFT
    def_bool $(shields_list_contains,Zippy2_central_left)

config SHIELD_Zippy2_PERIPHERAL_LEFT
    def_bool $(shields_list_contains,Zippy2_peripheral_left)

config SHIELD_Zippy2_PERIPHERAL_RIGHT
    def_bool $(shields_list_contains,Zippy2_peripheral_right)
```

## config/boards/shields/Zippy/Kconfig.defconfig
```kconfig
# Copyright (c) 2020 The ZMK Contributors
# SPDX-License-Identifier: MIT

if SHIELD_ZIPPY_LEFT

config ZMK_KEYBOARD_NAME
    default "Zippy"

config ZMK_SPLIT_ROLE_CENTRAL
    default y

endif

if SHIELD_ZIPPY_LEFT || SHIELD_ZIPPY_RIGHT

config ZMK_SPLIT
    default y

endif
```

## config/boards/shields/Zippy/Kconfig.shield
```kconfig
# Copyright (c) 2020 The ZMK Contributors
# SPDX-License-Identifier: MIT

config SHIELD_ZIPPY_LEFT
    def_bool $(shields_list_contains,Zippy_left)

config SHIELD_ZIPPY_RIGHT
    def_bool $(shields_list_contains,Zippy_right)
```
